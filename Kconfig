## Kconfig
```kconfig
config FLB36_STATUS_SCREEN
    bool "FLB36 raw-I2C dongle status screen"
    default n
    help
      Show both peripheral battery levels and the active host profile.

config FLB36_CHARGE_STATUS
    bool "FLB36 peripheral USB-power reporting"
    default n
    depends on BT_BAS
    help
      Include USB-power state in the battery value sent to the dongle.

config FLB36_RGB_PROXY
    bool "FLB36 split underglow proxy"
    default n
    help
      Expose underglow controls to Studio on the dongle and forward them to both halves.

config FLB36_I2C_TEST
    bool "FLB36 raw OLED diagnostic"
    default n
    help
      Write a checkerboard directly to SSD1306 display RAM.
```

## boards/shields/flb36/Kconfig.defconfig
```kconfig
if SHIELD_FLB36_DONGLE

config ZMK_KEYBOARD_NAME
    default "FLB36"

config ZMK_SPLIT_ROLE_CENTRAL
    default y

config ZMK_SPLIT
    default y

config ZMK_SPLIT_BLE_CENTRAL_PERIPHERALS
    default 2

config BT_MAX_CONN
    default 5

config BT_MAX_PAIRED
    default 5

endif

if SHIELD_FLB36_LEFT || SHIELD_FLB36_RIGHT || SHIELD_FLB36_DONGLE

config ZMK_SPLIT
    default y

endif
```

## boards/shields/flb36/Kconfig.shield
```kconfig
config SHIELD_FLB36_LEFT
    def_bool $(shields_list_contains,flb36_left)

config SHIELD_FLB36_RIGHT
    def_bool $(shields_list_contains,flb36_right)

config SHIELD_FLB36_DONGLE
    def_bool $(shields_list_contains,flb36_dongle)
```

## dts/bindings/behaviors/flb36,behavior-rgb-proxy.yaml
```yaml
description: FLB36 global underglow proxy

compatible: "flb36,behavior-rgb-proxy"

include: two_param.yaml
```
